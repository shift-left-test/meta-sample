## conf/layer.conf
```bitbake
BBPATH =. "${LAYERDIR}:"

BBFILES += " \
    ${LAYERDIR}/recipes-*/*/*.bb \
    ${LAYERDIR}/recipes-*/*/*.bbappend \
    ${@bb.utils.contains('BBFILE_COLLECTIONS', 'qt6-layer', '${LAYERDIR}/recipes-*/*/qt6/*.bb', '', d)} \
    ${@bb.utils.contains('BBFILE_COLLECTIONS', 'qt6-layer', '${LAYERDIR}/recipes-*/*/qt6/*.bbappend', '', d)} \
    ${@bb.utils.contains('BBFILE_COLLECTIONS', 'qt5-layer', '${LAYERDIR}/recipes-*/*/qt5/*.bb', '', d)} \
    ${@bb.utils.contains('BBFILE_COLLECTIONS', 'qt5-layer', '${LAYERDIR}/recipes-*/*/qt5/*.bbappend', '', d)} \
"

BBFILE_COLLECTIONS += "meta-sample"
BBFILE_PATTERN_meta-sample = "^${LAYERDIR}/"
BBFILE_PRIORITY_meta-sample = "82"

LAYERDEPENDS_meta-sample = "core"
LAYERSERIES_COMPAT_meta-sample = "jethro krogoth morty pyro rocko sumo thud warrior zeus dunfell gatesgarth hardknott honister kirkstone langdale mickledore nanbield scarthgap styhead"
```
